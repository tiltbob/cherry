## package/librepo/Config.in
```kconfig
config BR2_PACKAGE_LIBREPO
	bool "librepo"
	depends on BR2_PACKAGE_RPM6 # OpenPGP
	select BR2_PACKAGE_LIBCURL
	select BR2_PACKAGE_LIBGLIB2
	select BR2_PACKAGE_LIBXML2
	select BR2_PACKAGE_OPENSSL
	select BR2_PACKAGE_ZCHUNK
	help
	  Downloads rpm-md repository metadata and packages for dnf5.
	  OpenPGP signatures are verified through rpm, not GnuPG.

	  https://github.com/rpm-software-management/librepo
```

## package/libsolv-rpm/Config.in
```kconfig
config BR2_PACKAGE_LIBSOLV_RPM
	bool "libsolv-rpm"
	depends on !BR2_PACKAGE_LIBSOLV # same files
	depends on BR2_PACKAGE_RPM6
	select BR2_PACKAGE_BZIP2
	select BR2_PACKAGE_LIBXML2
	select BR2_PACKAGE_XZ
	select BR2_PACKAGE_ZCHUNK
	select BR2_PACKAGE_ZLIB
	select BR2_PACKAGE_ZSTD
	help
	  libsolv built as Fedora builds it, for dnf5: with the rpm
	  database, rpm-md repository and comps backends, and every
	  metadata compression. Buildroot's libsolv package has none of
	  them.

	  https://github.com/openSUSE/libsolv
```

## package/openchamber/Config.in
```kconfig
config BR2_PACKAGE_OPENCHAMBER
	bool "openchamber"
	# Runs on bun, upstream's prebuilt x86_64 binary (glibc).
	depends on BR2_x86_64
	depends on BR2_TOOLCHAIN_USES_GLIBC
	depends on !BR2_STATIC_LIBS
	depends on BR2_USE_MMU # git
	depends on BR2_PACKAGE_OPENCODE # the agent it runs
	select BR2_PACKAGE_BUN # its runtime
	select BR2_PACKAGE_GIT # diffs, worktrees and commits (simple-git)
	help
	  OpenChamber, a web workspace for running and reviewing
	  OpenCode's agent work: upstream's npm package @openchamber/web
	  with its dependencies, run on Bun, and openchamber, its
	  command line. /usr/libexec/openchamber-serve runs its server
	  for a systemd unit: openchamber.service below, or another
	  package's (Cherry's cherry.service).

	  https://github.com/openchamber/openchamber

if BR2_PACKAGE_OPENCHAMBER

config BR2_PACKAGE_OPENCHAMBER_SERVICE
	bool "openchamber.service"
	help
	  Run the server as a system service: the openchamber user,
	  with /var/lib/openchamber as its home, and
	  openchamber.service, which runs the server as that user,
	  listening on 127.0.0.1:3000. Given the systemd credential
	  openchamber.ui_password, it listens on every address instead,
	  with that password on the browser UI.

endif
```

## package/opencode/Config.in
```kconfig
config BR2_PACKAGE_OPENCODE
	bool "opencode"
	# Upstream's prebuilt x86_64 binary, linked against glibc.
	depends on BR2_x86_64
	depends on BR2_TOOLCHAIN_USES_GLIBC
	depends on !BR2_STATIC_LIBS
	depends on BR2_PACKAGE_BUSYBOX_SHOW_OTHERS # bash
	depends on BR2_PACKAGE_HOST_RUSTC_TARGET_ARCH_SUPPORTS # ripgrep
	select BR2_PACKAGE_BASH # the shell of its bash tool
	select BR2_PACKAGE_RIPGREP # its grep, glob and file search tools
	help
	  OpenCode, an AI coding agent: the opencode command, with its
	  server (`opencode serve`: the HTTP API and web UI) and its
	  clients. Just the binary; see below for running the server
	  as a service.

	  Upstream's prebuilt binary for x86_64: the "baseline" build,
	  which doesn't need AVX2, so it runs on any x86_64 machine or
	  VM CPU model. It is a Bun single-file executable, and strip
	  breaks it: BR2_STRIP_EXCLUDE_FILES must list opencode.

	  https://opencode.ai

if BR2_PACKAGE_OPENCODE

config BR2_PACKAGE_OPENCODE_SERVICE
	bool "opencode.service"
	help
	  Run the server as a system service: the opencode user, with
	  /var/lib/opencode as its home, and opencode.service, which
	  runs `opencode serve` as that user, listening on
	  127.0.0.1:4096 only, with its state (sessions, provider
	  credentials, logs) under /var/lib/opencode and a password
	  for the boot in /var/lib/opencode/server-password. Clients
	  reach it over SSH port forwarding.

endif
```

## package/pacman/Config.in
```kconfig
config BR2_PACKAGE_PACMAN
	bool "pacman"
	depends on BR2_USE_MMU # bash, gnupg2
	depends on BR2_USE_WCHAR # libarchive
	depends on !BR2_STATIC_LIBS # gnupg2
	depends on BR2_TOOLCHAIN_HAS_THREADS # gnupg2
	depends on BR2_PACKAGE_LIBGPG_ERROR_ARCH_SUPPORTS # libgpgme
	select BR2_PACKAGE_ARCHLINUX_KEYRING # pacman-init.service
	select BR2_PACKAGE_ATTR # libarchive: file capabilities
	select BR2_PACKAGE_BASH # runtime: pacman-key
	select BR2_PACKAGE_LIBARCHIVE
	select BR2_PACKAGE_LIBCURL
	select BR2_PACKAGE_LIBGPGME # selects gnupg2, run by gpgme
	select BR2_PACKAGE_OPENSSL
	select BR2_PACKAGE_ZSTD # libarchive: .pkg.tar.zst
	select BR2_PACKAGE_XZ # libarchive: .pkg.tar.xz
	help
	  The Arch Linux package manager, set up to install packages
	  from the Arch Linux repositories into another root (pacman
	  -r, pacstrap), not to manage the host. makepkg and the
	  repository tools are not installed.

	  /etc/pacman.d/gnupg links to /var/lib/pacman/gnupg, where
	  pacman-init.service creates the keyring at boot.

	  https://pacman.archlinux.page/
```

## package/rpm-sequoia/Config.in
```kconfig
config BR2_PACKAGE_RPM_SEQUOIA
	bool "rpm-sequoia"
	depends on BR2_PACKAGE_HOST_RUSTC_TARGET_ARCH_SUPPORTS
	select BR2_PACKAGE_HOST_RUSTC
	select BR2_PACKAGE_OPENSSL
	help
	  The OpenPGP backend of rpm >= 4.19, built on Sequoia PGP
	  with its OpenSSL cryptography backend.

	  https://github.com/rpm-software-management/rpm-sequoia
```

## package/rpm6/Config.in
```kconfig
config BR2_PACKAGE_RPM6
	bool "rpm6"
	depends on !BR2_PACKAGE_RPM # same files
	depends on BR2_INSTALL_LIBSTDCPP # C++20
	depends on BR2_TOOLCHAIN_GCC_AT_LEAST_11 # C++20
	depends on !BR2_STATIC_LIBS # plugins
	depends on BR2_TOOLCHAIN_HAS_THREADS
	depends on BR2_USE_MMU # fork()
	depends on BR2_USE_WCHAR # libarchive
	depends on BR2_PACKAGE_HOST_RUSTC_TARGET_ARCH_SUPPORTS # rpm-sequoia
	depends on BR2_PACKAGE_LUA && !BR2_PACKAGE_LUA_5_1
	select BR2_PACKAGE_BZIP2
	select BR2_PACKAGE_FILE # libmagic
	select BR2_PACKAGE_LIBARCHIVE
	select BR2_PACKAGE_OPENSSL
	select BR2_PACKAGE_POPT
	select BR2_PACKAGE_RPM_SEQUOIA
	select BR2_PACKAGE_SQLITE
	select BR2_PACKAGE_XZ
	select BR2_PACKAGE_ZLIB
	select BR2_PACKAGE_ZSTD
	help
	  The RPM Package Manager, version 6. Buildroot's rpm package
	  is 4.18, which is too old for dnf5 and for current
	  distributions, whose packages rely on rpm creating their
	  sysusers.d users.

	  Signatures are verified by rpm-sequoia. The rpmdb backends
	  are sqlite (the default) and ndb.

	  Installing packages that declare sysusers.d users runs
	  /usr/libexec/rpm/sysusers.sh, which needs bash and useradd,
	  groupadd and usermod (e.g. from shadow-useradd).

	  https://rpm.org/

comment "rpm6 needs a toolchain w/ C++, wchar, threads, dynamic library, gcc >= 11, and lua >= 5.3"
	depends on BR2_PACKAGE_HOST_RUSTC_TARGET_ARCH_SUPPORTS
	depends on BR2_USE_MMU
	depends on !BR2_INSTALL_LIBSTDCPP || !BR2_TOOLCHAIN_GCC_AT_LEAST_11 || \
		BR2_STATIC_LIBS || !BR2_TOOLCHAIN_HAS_THREADS || \
		!BR2_USE_WCHAR || !BR2_PACKAGE_LUA || BR2_PACKAGE_LUA_5_1
```
