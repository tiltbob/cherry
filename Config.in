## Config.in
```kconfig
menu "Cherry packages"
# One line per package, sorted:
# source "$BR2_EXTERNAL_CHERRY_PATH/package/<name>/Config.in"
source "$BR2_EXTERNAL_CHERRY_PATH/package/arch-install-scripts/Config.in"
source "$BR2_EXTERNAL_CHERRY_PATH/package/archlinux-keyring/Config.in"
source "$BR2_EXTERNAL_CHERRY_PATH/package/bun/Config.in"
source "$BR2_EXTERNAL_CHERRY_PATH/package/cherry/Config.in"
source "$BR2_EXTERNAL_CHERRY_PATH/package/cherry-pit/Config.in"
source "$BR2_EXTERNAL_CHERRY_PATH/package/cherry-secureboot/Config.in"
source "$BR2_EXTERNAL_CHERRY_PATH/package/debian-archive-keyring/Config.in"
source "$BR2_EXTERNAL_CHERRY_PATH/package/debootstrap/Config.in"
source "$BR2_EXTERNAL_CHERRY_PATH/package/debootstrap-pkgdetails/Config.in"
source "$BR2_EXTERNAL_CHERRY_PATH/package/distribution-gpg-keys/Config.in"
source "$BR2_EXTERNAL_CHERRY_PATH/package/dnf5/Config.in"
source "$BR2_EXTERNAL_CHERRY_PATH/package/exocarp/Config.in"
source "$BR2_EXTERNAL_CHERRY_PATH/package/librepo/Config.in"
source "$BR2_EXTERNAL_CHERRY_PATH/package/libsolv-rpm/Config.in"
source "$BR2_EXTERNAL_CHERRY_PATH/package/openchamber/Config.in"
source "$BR2_EXTERNAL_CHERRY_PATH/package/opencode/Config.in"
source "$BR2_EXTERNAL_CHERRY_PATH/package/pacman/Config.in"
source "$BR2_EXTERNAL_CHERRY_PATH/package/rpm-sequoia/Config.in"
source "$BR2_EXTERNAL_CHERRY_PATH/package/rpm6/Config.in"
source "$BR2_EXTERNAL_CHERRY_PATH/package/rpmstrap/Config.in"
source "$BR2_EXTERNAL_CHERRY_PATH/package/shadow-useradd/Config.in"
source "$BR2_EXTERNAL_CHERRY_PATH/package/toml11/Config.in"
source "$BR2_EXTERNAL_CHERRY_PATH/package/ubuntu-keyring/Config.in"
endmenu
```

## configs/cherry_sdk_x86_64_defconfig
```kconfig
BR2_x86_64=y
BR2_TOOLCHAIN_BUILDROOT_CXX=y
BR2_CCACHE=y
BR2_DOWNLOAD_FORCE_CHECK_HASHES=y
BR2_INIT_NONE=y
# BR2_PACKAGE_BUSYBOX is not set
# BR2_TARGET_ROOTFS_TAR is not set
```

## configs/cherry_x86_64_defconfig
```kconfig
BR2_x86_64=y
BR2_TOOLCHAIN_BUILDROOT_CXX=y
BR2_CCACHE=y
BR2_GLOBAL_PATCH_DIR="$(BR2_EXTERNAL_CHERRY_PATH)/patches"
BR2_DOWNLOAD_FORCE_CHECK_HASHES=y
BR2_TARGET_GENERIC_HOSTNAME="cherry"
BR2_TARGET_GENERIC_ISSUE="Welcome to Cherry"
BR2_INIT_SYSTEMD=y
# BR2_INIT_SYSTEMD_POPULATE_TMPFILES is not set
BR2_TARGET_GENERIC_GETTY_PORT="tty1"
# BR2_TARGET_GENERIC_REMOUNT_ROOTFS_RW is not set
BR2_ROOTFS_OVERLAY="$(BR2_EXTERNAL_CHERRY_PATH)/board/x86_64/rootfs-overlay"
BR2_ROOTFS_POST_BUILD_SCRIPT="$(BR2_EXTERNAL_CHERRY_PATH)/board/x86_64/post-build.sh"
BR2_ROOTFS_POST_FAKEROOT_SCRIPT="$(BR2_EXTERNAL_CHERRY_PATH)/board/x86_64/post-fakeroot.sh"
BR2_ROOTFS_POST_IMAGE_SCRIPT="$(BR2_EXTERNAL_CHERRY_PATH)/board/x86_64/post-image.sh"
BR2_LINUX_KERNEL=y
BR2_LINUX_KERNEL_DEFCONFIG="x86_64"
BR2_LINUX_KERNEL_CONFIG_FRAGMENT_FILES="$(BR2_EXTERNAL_CHERRY_PATH)/board/x86_64/linux.fragment"
BR2_LINUX_KERNEL_NEEDS_HOST_OPENSSL=y
BR2_LINUX_KERNEL_NEEDS_HOST_LIBELF=y
BR2_PACKAGE_LUA=y
BR2_PACKAGE_CA_CERTIFICATES=y
BR2_PACKAGE_NFTABLES=y
BR2_PACKAGE_OPENSSH=y
BR2_PACKAGE_SYSTEMD_BOOT=y
BR2_PACKAGE_SYSTEMD_LOGIND=y
BR2_PACKAGE_SYSTEMD_MACHINED=y
BR2_PACKAGE_SYSTEMD_NSPAWN=y
BR2_PACKAGE_TPM2_TOOLS=y
BR2_TARGET_ROOTFS_CPIO=y
BR2_TARGET_ROOTFS_CPIO_ZSTD=y
# BR2_TARGET_ROOTFS_TAR is not set
BR2_PACKAGE_ARCH_INSTALL_SCRIPTS=y
BR2_PACKAGE_DEBOOTSTRAP=y
BR2_PACKAGE_PACMAN=y
BR2_PACKAGE_RPMSTRAP=y
```

## package/arch-install-scripts/Config.in
```kconfig
config BR2_PACKAGE_ARCH_INSTALL_SCRIPTS
	bool "arch-install-scripts"
	depends on BR2_PACKAGE_PACMAN
	depends on BR2_PACKAGE_BUSYBOX_SHOW_OTHERS # coreutils
	select BR2_PACKAGE_BASH
	select BR2_PACKAGE_COREUTILS # cp --no-preserve=ownership
	select BR2_PACKAGE_UTIL_LINUX
	select BR2_PACKAGE_UTIL_LINUX_MOUNT # umount --lazy
	select BR2_PACKAGE_UTIL_LINUX_UNSHARE # unshare --fork --pid
	help
	  pacstrap and arch-chroot, to bootstrap and enter an Arch
	  Linux root. genfstab is not installed.

	  https://gitlab.archlinux.org/archlinux/arch-install-scripts
```

## package/archlinux-keyring/Config.in
```kconfig
config BR2_PACKAGE_ARCHLINUX_KEYRING
	bool "archlinux-keyring"
	help
	  The Arch Linux PGP keyring, which pacman-key --populate
	  imports to verify packages from the Arch Linux repositories.

	  https://gitlab.archlinux.org/archlinux/archlinux-keyring
```

## package/bun/Config.in
```kconfig
config BR2_PACKAGE_BUN
	bool "bun"
	# Upstream's prebuilt x86_64 binary, linked against glibc.
	depends on BR2_x86_64
	depends on BR2_TOOLCHAIN_USES_GLIBC
	depends on !BR2_STATIC_LIBS
	help
	  Bun, a JavaScript runtime: the bun command, for OpenChamber's
	  server. Upstream's prebuilt binary for x86_64, the "baseline"
	  build that doesn't need AVX2, so it runs on any x86_64 machine
	  or VM CPU model.

	  https://bun.sh
```

## package/cherry-init/Config.in
```kconfig
config BR2_PACKAGE_CHERRY_INIT
	bool "cherry-init"
	depends on BR2_TOOLCHAIN_USES_GLIBC
	help
	  Static /init for Cherry's initramfs: mounts the squashfs root
	  filesystem shipped inside the initramfs read-only and starts
	  systemd from it. Installed to the images directory, not to the
	  target.
```

## package/cherry-pit/Config.in
```kconfig
config BR2_PACKAGE_CHERRY_PIT
	bool "cherry-pit"
	help
	  The /init of Cherry's initramfs: it mounts the root
	  filesystem, a compressed EROFS image in the initramfs,
	  straight from the file, gives it a tmpfs /run with the UKI's
	  PCR signature and public key, which systemd-stub left in the
	  initramfs, and runs the /init of that root.

	  A static binary, installed to the images directory, where
	  post-image.sh packs it into the initramfs.
```

## package/cherry-secureboot/Config.in
```kconfig
config BR2_PACKAGE_CHERRY_SECUREBOOT
	bool "cherry-secureboot"
	depends on BR2_INIT_SYSTEMD
	depends on BR2_PACKAGE_TPM2_TOOLS # tpm2_eventlog
	help
	  cherry-secureboot.service: on a machine whose firmware is in
	  Secure Boot setup mode, enroll Cherry's keys (scripts/
	  secureboot.py init) and the hashes of the option ROMs the
	  firmware loaded, from the TPM's event log, then reboot into
	  Secure Boot. Otherwise, report whether Secure Boot is on,
	  and on a machine with Cherry's keys, set dbx to the revoked
	  release keys the image carries (scripts/secureboot.py
	  revoke) when it lacks them.

if BR2_PACKAGE_CHERRY_SECUREBOOT

config BR2_PACKAGE_CHERRY_SECUREBOOT_KEYS
	string "directory of the keys"
	default "$(BR2_EXTERNAL_CHERRY_PATH)/board/x86_64/secureboot"
	help
	  The directory of PK.auth, KEK.auth and db.auth, as
	  scripts/secureboot.py init writes them, and of dbx.auth, the
	  revoked release keys, when revoke wrote one. Without them,
	  the image enrolls nothing and the service doesn't start.
	  With release.key beside release.crt in it, a local chain's
	  (scripts/secureboot.py issue --key-out), post-image.sh signs
	  the image with it, for machines that enrolled that chain.

endif
```

## package/cherry-stage1/Config.in
```kconfig
config BR2_PACKAGE_CHERRY_STAGE1
	bool "cherry-stage1"
	help
	  The /init of Cherry's initramfs: it mounts the root
	  filesystem, a compressed EROFS image in the initramfs,
	  straight from the file, and runs the /init of that root.

	  A static binary, installed to the images directory, where
	  post-image.sh packs it into the initramfs.
```

## package/cherry/Config.in
```kconfig
config BR2_PACKAGE_CHERRY
	bool "cherry"
	depends on BR2_PACKAGE_OPENCHAMBER
	depends on BR2_PACKAGE_SYSTEMD_MACHINED # the user's containers
	depends on BR2_PACKAGE_SYSTEMD_NSPAWN # cherry-image
	depends on BR2_PACKAGE_SYSTEMD_POLKIT # its machinectl privileges
	depends on BR2_PACKAGE_SYSTEMD_REPART # cherry-storage: claims disks
	depends on BR2_PACKAGE_CRYPTSETUP # cherry-storage: the disks' LUKS2 volumes
	depends on BR2_PACKAGE_BUSYBOX_SHOW_OTHERS # coreutils, tar
	depends on BR2_USE_MMU # coreutils, tar, lvm2
	depends on BR2_USE_WCHAR # coreutils, tar
	depends on BR2_TOOLCHAIN_HAS_THREADS # lvm2
	depends on !BR2_STATIC_LIBS # lvm2's standard install
	select BR2_PACKAGE_COREUTILS # cherry-image: mv -T
	select BR2_PACKAGE_TAR # cherry-image: the recipe
	select BR2_PACKAGE_BTRFS_PROGS # cherry-storage: /var and the volumes; cherry-bootstrap: a tree on it is a subvolume
	select BR2_PACKAGE_LVM2 # cherry-storage: the pools
	select BR2_PACKAGE_LVM2_STANDARD_INSTALL # lvm, not only dmsetup
	select BR2_PACKAGE_UTIL_LINUX
	select BR2_PACKAGE_UTIL_LINUX_WIPEFS # claiming a disk
	select BR2_PACKAGE_UBUNTU_KEYRING if BR2_PACKAGE_DEBOOTSTRAP # the ubuntu-noble profile
	help
	  Cherry's own service: the cherry user, with /var/lib/cherry as
	  its home, and cherry.service, which runs OpenChamber's server
	  as that user, on 127.0.0.1:3000 only, with the OpenCode it
	  runs on loopback too, with no password on the browser UI.
	  cherry-connect-url.service shows the link that pairs another
	  OpenChamber app with it on the console, once it is online.

	  The cherry user manages containers: polkit rules let it start,
	  stop, enter and remove them with machinectl, and start
	  cherry-bootstrap@.service, which creates one as root with
	  debootstrap, rpmstrap or pacstrap, and cherry-image@.service,
	  which builds an image from a recipe (packages, files, a
	  script run in it under systemd-nspawn). Images stay on the
	  machine that built them.

	  On those, images and environments: an image is built from a
	  profile in /usr/lib/cherry/profiles (recipes written by a
	  person, one per distribution) or /var/lib/cherry/profiles,
	  and never started; an environment is a clone of an image
	  (machinectl clone: on the disk's btrfs, a snapshot of it),
	  started, stopped and removed on its own.
	  OpenChamber gets a built-in extension for them, Environments:
	  a panel, the /env command and a service with the verbs.

	  It manages storage too: cherry-storage@.service, which runs as
	  root, claims disks for it, which erases them and makes each a
	  LUKS2 volume the TPM unlocks under a signed Cherry image
	  alone, and makes LVM pools of them,
	  hard disks or SSDs, with SSDs as a pool's cache (dm-cache),
	  and volumes in the pools, btrfs, mounted for it under
	  /var/lib/cherry/volumes. The pool cherry is the machine's
	  own, and its volume var is /var: in RAM, 128 MiB, until the
	  agent gives the pool disks. cherry-storage.service unlocks,
	  activates and mounts it all at boot, /var first.

	  OpenCode gets tools for all of it, and nothing else: MCP
	  servers, cherry-machines-mcp (the environment verbs) and
	  cherry-storage-mcp, and skills, in /etc/opencode, whose
	  permissions deny its other tools.
```

## package/debian-archive-keyring/Config.in
```kconfig
config BR2_PACKAGE_DEBIAN_ARCHIVE_KEYRING
	bool "debian-archive-keyring"
	help
	  The OpenPGP keys that sign the Debian archive, installed in
	  /usr/share/keyrings for debootstrap.

	  https://salsa.debian.org/release-team/debian-archive-keyring
```

## package/debootstrap/Config.in
```kconfig
config BR2_PACKAGE_DEBOOTSTRAP
	bool "debootstrap"
	depends on BR2_PACKAGE_BUSYBOX_SHOW_OTHERS # wget
	depends on BR2_USE_WCHAR # wget
	depends on BR2_PACKAGE_GNUPG2_DEPENDS # gnupg2
	depends on !BR2_PACKAGE_GNUPG # gnupg2
	select BR2_PACKAGE_DEBIAN_ARCHIVE_KEYRING
	select BR2_PACKAGE_DEBOOTSTRAP_PKGDETAILS
	select BR2_PACKAGE_GNUPG2
	select BR2_PACKAGE_GNUPG2_GPGV # Release signatures
	select BR2_PACKAGE_OPENSSL # wget: https
	select BR2_PACKAGE_UTIL_LINUX
	select BR2_PACKAGE_UTIL_LINUX_MOUNT # umount --lazy
	select BR2_PACKAGE_WGET # BusyBox wget has no TLS
	select BR2_PACKAGE_ZSTD # zstdcat: zstd-compressed .debs (Ubuntu)
	help
	  Bootstrap a Debian (or Ubuntu) root filesystem into a
	  directory, e.g. /var/lib/machines/<name> for systemd-nspawn,
	  without dpkg or apt on the host.

	  Release files are verified with gpgv against
	  debian-archive-keyring. .debs are unpacked with ar, tar and
	  xzcat/zcat from BusyBox's default configuration.

	  https://wiki.debian.org/Debootstrap

comment "debootstrap needs a toolchain w/ wchar, threads, dynamic library"
	depends on BR2_PACKAGE_BUSYBOX_SHOW_OTHERS
	depends on BR2_USE_MMU
	depends on BR2_PACKAGE_LIBGPG_ERROR_ARCH_SUPPORTS
	depends on !BR2_USE_WCHAR || !BR2_TOOLCHAIN_HAS_THREADS || \
		BR2_STATIC_LIBS
```

## package/distribution-gpg-keys/Config.in
```kconfig
config BR2_PACKAGE_DISTRIBUTION_GPG_KEYS
	bool "distribution-gpg-keys"
	help
	  The OpenPGP keys that sign the packages of RPM-based
	  distributions (Fedora, CentOS, AlmaLinux, Rocky Linux,
	  openSUSE, ...), as used by mock. Installed in
	  /usr/share/distribution-gpg-keys, without the copr keys.

	  https://github.com/rpm-software-management/distribution-gpg-keys
```

## package/dnf5/Config.in
```kconfig
config BR2_PACKAGE_DNF5
	bool "dnf5"
	depends on !BR2_PACKAGE_LIBSOLV # libsolv-rpm
	depends on !BR2_PACKAGE_RPM # rpm6
	depends on BR2_INSTALL_LIBSTDCPP # C++20
	depends on BR2_TOOLCHAIN_GCC_AT_LEAST_11 # C++20
	depends on !BR2_STATIC_LIBS # rpm6
	depends on BR2_TOOLCHAIN_HAS_THREADS # rpm6, libglib2
	depends on BR2_USE_MMU # rpm6, libglib2
	depends on BR2_USE_WCHAR # rpm6, libglib2
	depends on BR2_PACKAGE_HOST_RUSTC_TARGET_ARCH_SUPPORTS # rpm-sequoia
	depends on BR2_PACKAGE_LUA && !BR2_PACKAGE_LUA_5_1 # rpm6
	select BR2_PACKAGE_FMT
	select BR2_PACKAGE_JSON_C
	select BR2_PACKAGE_LIBGLIB2
	select BR2_PACKAGE_LIBREPO
	select BR2_PACKAGE_LIBSOLV_RPM
	select BR2_PACKAGE_LIBXML2
	select BR2_PACKAGE_RPM6
	select BR2_PACKAGE_SQLITE
	select BR2_PACKAGE_TOML11
	select BR2_PACKAGE_UTIL_LINUX
	select BR2_PACKAGE_UTIL_LINUX_LIBSMARTCOLS
	help
	  The dnf5 package manager, with /usr/bin/dnf linking to it as
	  on Fedora. On Cherry it installs RPM-based distributions into
	  a directory (dnf5 --installroot; see rpmstrap), not onto the
	  host.

	  Built without the D-Bus daemon, the CLI plugins,
	  modularity (EL8 modules), bindings and documentation.

	  https://github.com/rpm-software-management/dnf5

comment "dnf5 needs a toolchain w/ C++, wchar, threads, dynamic library, gcc >= 11, and lua >= 5.3"
	depends on BR2_PACKAGE_HOST_RUSTC_TARGET_ARCH_SUPPORTS
	depends on BR2_USE_MMU
	depends on !BR2_INSTALL_LIBSTDCPP || !BR2_TOOLCHAIN_GCC_AT_LEAST_11 || \
		BR2_STATIC_LIBS || !BR2_TOOLCHAIN_HAS_THREADS || \
		!BR2_USE_WCHAR || !BR2_PACKAGE_LUA || BR2_PACKAGE_LUA_5_1
```

## package/exocarp/Config.in
```kconfig
config BR2_PACKAGE_EXOCARP
	bool "exocarp"
	depends on !BR2_STATIC_LIBS # tpm2-tss
	depends on BR2_PACKAGE_OPENSSH # sshd, whose host key agent it is
	select BR2_PACKAGE_OPENSSL
	select BR2_PACKAGE_TPM2_TSS
	help
	  Cherry's SSH host key agent: sshd's host key is a key of the
	  machine's TPM, which signs with it, so the private key never
	  leaves the TPM. The key is the TPM's primary ECC NIST P-256
	  signing key under its endorsement hierarchy, from a fixed
	  template, so the TPM derives the same key at every boot, from
	  the endorsement seed that also gives the machine its identity:
	  nothing is stored, and a machine without a disk keeps its host
	  key across boots too.

	  exocarp.socket writes the public key to /run/exocarp at boot
	  and exocarp.service answers sshd's signing requests on
	  /run/exocarp/socket, in the ssh-agent protocol (sshd's
	  HostKeyAgent); its sshd.service drop-in points sshd at both.

comment "exocarp needs a toolchain w/ dynamic library"
	depends on BR2_STATIC_LIBS
```

## package/kubo/Config.in
```kconfig
config BR2_PACKAGE_KUBO
	bool "kubo"
	depends on BR2_PACKAGE_HOST_GO_TARGET_ARCH_SUPPORTS
	depends on BR2_PACKAGE_TPM2_TOOLS # ipfs-identity
	select BR2_PACKAGE_HOST_GO
	help
	  Kubo, the reference IPFS implementation: the ipfs command
	  and daemon. ipfs.service runs the daemon as the ipfs user,
	  with its repository in /var/lib/ipfs, and login shells set
	  IPFS_PATH to it so that ipfs commands reach the daemon.

	  ipfs-identity.service creates that repository with a key
	  derived from the TPM, so that the node's peer ID is the
	  same at every boot.

	  Built without FUSE (ipfs mount).

	  https://github.com/ipfs/kubo
```
