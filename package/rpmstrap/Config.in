## package/rpmstrap/Config.in
```kconfig
config BR2_PACKAGE_RPMSTRAP
	bool "rpmstrap"
	depends on BR2_PACKAGE_BUSYBOX_SHOW_OTHERS # bash
	depends on BR2_TOOLCHAIN_HEADERS_AT_LEAST_4_14 # shadow-useradd
	depends on !BR2_PACKAGE_LIBSOLV # dnf5
	depends on !BR2_PACKAGE_RPM # dnf5
	depends on BR2_INSTALL_LIBSTDCPP # dnf5
	depends on BR2_TOOLCHAIN_GCC_AT_LEAST_11 # dnf5
	depends on !BR2_STATIC_LIBS # dnf5
	depends on BR2_TOOLCHAIN_HAS_THREADS # dnf5
	depends on BR2_USE_MMU # dnf5, bash
	depends on BR2_USE_WCHAR # dnf5
	depends on BR2_PACKAGE_HOST_RUSTC_TARGET_ARCH_SUPPORTS # dnf5
	depends on BR2_PACKAGE_LUA && !BR2_PACKAGE_LUA_5_1 # dnf5
	select BR2_PACKAGE_BASH
	select BR2_PACKAGE_DISTRIBUTION_GPG_KEYS
	select BR2_PACKAGE_DNF5
	select BR2_PACKAGE_SHADOW_USERADD if !BR2_PACKAGE_SHADOW # rpm6: sysusers.sh
	select BR2_PACKAGE_UTIL_LINUX
	select BR2_PACKAGE_UTIL_LINUX_MOUNT
	select BR2_PACKAGE_UTIL_LINUX_UNSHARE
	help
	  Bootstrap an RPM-based distribution (Fedora, CentOS Stream,
	  AlmaLinux, Rocky Linux) into a directory, e.g.
	  /var/lib/machines/<name> for systemd-nspawn:

	    rpmstrap fedora 44 /var/lib/machines/fedora

	  A wrapper around dnf5 --installroot, with the repositories
	  of each distribution in /usr/share/rpmstrap and their keys
	  from distribution-gpg-keys.
```

## package/shadow-useradd/Config.in
```kconfig
config BR2_PACKAGE_SHADOW_USERADD
	bool "shadow-useradd"
	depends on !BR2_PACKAGE_SHADOW # same files
	depends on !BR2_STATIC_LIBS
	depends on BR2_TOOLCHAIN_HEADERS_AT_LEAST_4_14
	select BR2_PACKAGE_LIBXCRYPT if BR2_TOOLCHAIN_USES_GLIBC
	help
	  useradd, groupadd and usermod from shadow, without the rest
	  of the suite (login, passwd, ...), which would replace
	  BusyBox's.

	  rpm's sysusers.sh runs them with --root to create the
	  sysusers.d users and groups of packages it installs into
	  another root.

	  https://github.com/shadow-maint/shadow
```

## package/toml11/Config.in
```kconfig
config BR2_PACKAGE_TOML11
	bool "toml11"
	depends on BR2_INSTALL_LIBSTDCPP
	help
	  A header-only C++ TOML parser. Only headers and CMake files
	  are installed, to staging.

	  https://github.com/ToruNiina/toml11
```

## package/ubuntu-keyring/Config.in
```kconfig
config BR2_PACKAGE_UBUNTU_KEYRING
	bool "ubuntu-keyring"
	help
	  The OpenPGP keys that sign the Ubuntu archive, installed as
	  /usr/share/keyrings/ubuntu-archive-keyring.gpg for debootstrap
	  (--keyring), which verifies Debian's archive by default.

	  https://launchpad.net/ubuntu/+source/ubuntu-keyring
```
